/* 
Rotator cuff recovery 
@RoniBandini, March 2022, Argentina
Edge Impulse and Arduino BLE 33 Sense 
Oled Screen VCC to Arduino 3.3v, GND to Arduino GND, SDA to A4, SCL to A5
*/

/* Includes ---------------------------------------------------------------- */
#include <Rotator_cuff_inferencing.h>
#include <Arduino_LSM9DS1.h>

#include <SPI.h>
#include <Wire.h>
#include <Adafruit_GFX.h>
#include <Adafruit_SSD1306.h>

#define SCREEN_WIDTH 128  
#define SCREEN_HEIGHT 32  
#define OLED_RESET     -1  
#define SCREEN_ADDRESS 0x3C  
Adafruit_SSD1306 display(SCREEN_WIDTH, SCREEN_HEIGHT, &Wire, OLED_RESET);

#define imageWidthLogo 128
#define imageHeightLogo 32

const unsigned char logo [] PROGMEM ={
 0x00, 0x00, 0x00, 0x00, 0x00, 0x00, 0x00, 0x00, 0x00, 0x00, 0x00, 0x00, 0x00, 0x00, 0xc0, 0x00, 
  0x00, 0x00, 0x00, 0x00, 0x00, 0x00, 0x00, 0x00, 0x00, 0x00, 0x00, 0x00, 0x03, 0x81, 0xc0, 0x00, 
  0x00, 0x00, 0x00, 0x00, 0x00, 0x00, 0x00, 0x00, 0x00, 0x00, 0x00, 0x00, 0x01, 0x80, 0x80, 0x00, 
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  0x00, 0x00, 0x00, 0x00, 0x00, 0x00, 0x00, 0x00, 0x00, 0x00, 0x00, 0x00, 0x01, 0x80, 0x21, 0x00
};


const unsigned char edge [] PROGMEM = {
  0x00, 0x00, 0x00, 0x00, 0x00, 0x00, 0x00, 0x00, 0x00, 0x00, 0x00, 0x00, 0x00, 0x00, 0x00, 0x00, 
  0x00, 0x00, 0x00, 0x00, 0x00, 0x00, 0x00, 0x00, 0x00, 0x00, 0x00, 0x00, 0x00, 0x00, 0x00, 0x00, 
  0x00, 0x00, 0x00, 0x00, 0x00, 0x00, 0x00, 0x00, 0x00, 0x00, 0x00, 0x00, 0x00, 0x00, 0x00, 0x00, 
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  0x00, 0x00, 0x00, 0x00, 0x00, 0x00, 0x00, 0x00, 0x00, 0x00, 0x00, 0x00, 0x00, 0x00, 0x00, 0x00
};

#define CONVERT_G_TO_MS2    9.80665f
static bool debug_nn = false;  
static uint32_t run_inference_every_ms = 400;
static rtos::Thread inference_thread(osPriorityLow);
static float buffer[EI_CLASSIFIER_DSP_INPUT_FRAME_SIZE] = { 0 };
static float inference_buffer[EI_CLASSIFIER_DSP_INPUT_FRAME_SIZE];

void run_inference_background();

int counterRight=0;
int counterLeft=0;
int counterUp=0;
int rightLimit=10;
int leftLimit=10;
int upLimit=5;
int myCounter=1;
int updateScreen=0;
String lastPrediction="Idle";

void setup()
{

    Serial.begin(115200);
    Serial.println("Rotator Cuff Recovery - Roni Bandini");

    if (!IMU.begin()) {
        ei_printf("Failed to initialize IMU!\r\n");
    }
    else {
        ei_printf("IMU initialized\r\n");
    }

    if (EI_CLASSIFIER_RAW_SAMPLES_PER_FRAME != 3) {
        ei_printf("ERR: EI_CLASSIFIER_RAW_SAMPLES_PER_FRAME should be equal to 3 (the 3 sensor axes)\n");
        return;
    }

     if(!display.begin(SSD1306_SWITCHCAPVCC, SCREEN_ADDRESS)) {
        Serial.println(F("SSD1306 allocation failed"));
        for(;;); // Don't proceed, loop forever
    }

    display.display();
    delay(1000); 
    display.clearDisplay();   
    display.drawBitmap(0, 0,  logo, imageWidthLogo, imageHeightLogo, 1); 
    display.display();   
    delay(2000);

    display.clearDisplay();   
    display.drawBitmap(0, 0,  edge, imageWidthLogo, imageHeightLogo, 1); 
    display.display();   
    delay(2000);

    display.clearDisplay();
    display.setTextSize(1);            
    display.setTextColor(SSD1306_WHITE); 
    display.println("Rotator Cuff Recovery");
    display.println("Arduino BLE33 TinyML"); 
    display.println("@RoniBandini 3/22"); 
    display.println("Device ready..."); 
    display.display();
    delay(2000); 

    inference_thread.start(mbed::callback(&run_inference_background));
}


void ei_printf(const char *format, ...) {
   static char print_buf[1024] = { 0 };

   va_list args;
   va_start(args, format);
   int r = vsnprintf(print_buf, sizeof(print_buf), format, args);
   va_end(args);

   if (r > 0) {
       Serial.write(print_buf);
   }
}


void run_inference_background()
{
    
    
    // wait until we have a full buffer
    delay((EI_CLASSIFIER_INTERVAL_MS * EI_CLASSIFIER_RAW_SAMPLE_COUNT) + 100);

    // This is a structure that smoothens the output result
    // With the default settings 70% of readings should be the same before classifying.
    ei_classifier_smooth_t smooth;
    ei_classifier_smooth_init(&smooth, 10 /* no. of readings */, 7 /* min. readings the same */, 0.65 /* min. confidence */, 0.3 /* max anomaly */);

    while (1) {
        // copy the buffer
        memcpy(inference_buffer, buffer, EI_CLASSIFIER_DSP_INPUT_FRAME_SIZE * sizeof(float));

        // Turn the raw buffer in a signal which we can the classify
        signal_t signal;
        int err = numpy::signal_from_buffer(inference_buffer, EI_CLASSIFIER_DSP_INPUT_FRAME_SIZE, &signal);
        if (err != 0) {
            ei_printf("Failed to create signal from buffer (%d)\n", err);
            return;
        }

        // Run the classifier
        ei_impulse_result_t result = { 0 };

        err = run_classifier(&signal, &result, debug_nn);
        if (err != EI_IMPULSE_OK) {
            ei_printf("ERR: Failed to run classifier (%d)\n", err);
            return;
        }

        // print the predictions
        ei_printf("Predictions ");
        ei_printf("(DSP: %d ms., Classification: %d ms., Anomaly: %d ms.)",
            result.timing.dsp, result.timing.classification, result.timing.anomaly);
        ei_printf(": ");

        // ei_classifier_smooth_update yields the predicted label
        const char *prediction = ei_classifier_smooth_update(&smooth, &result);
        ei_printf("%s ", prediction);
        
        if (prediction=="Right" and prediction!=lastPrediction){
              
              counterRight=counterRight+1; 
              updateScreen=1;
              
          }
         
        if (prediction=="Left" and prediction!=lastPrediction){
          
            counterLeft=counterLeft+1;   
            updateScreen=1;
               
         }

         if (prediction=="Up" and prediction!=lastPrediction){
          
            counterUp=counterUp+1;   
            updateScreen=1;
               
         }
       
         lastPrediction=prediction;

         if (updateScreen==1){
          
              display.clearDisplay();
              display.setCursor(0, 0); 
              display.println("Rotator Cuff Mobility");
              display.print("Right : ");

              myCounter=1;
              
              while (myCounter<=rightLimit){

                if (myCounter<counterRight) {
                  display.print("*");
                  }
                else {
                  display.print("_");
                  }
                myCounter++;
                }
              display.print("\r\n");  
                
              display.print("Left  : ");

              myCounter=1;
              
              while (myCounter<=leftLimit){

                if (myCounter<counterLeft) {
                  display.print("*");
                  }
                else {
                  display.print("_");
                  }
                myCounter++;
                }
              display.print("\r\n"); 
                       
              display.print("Up    : ");  

              myCounter=1;
              
              while (myCounter<=upLimit){

                if (myCounter<counterUp) {
                  display.print("*");
                  }
                else {
                  display.print("_");
                  }
                myCounter++;
                }
              display.print("\r\n");
              
              display.display();

              updateScreen=0;
          }

        if (counterRight>=rightLimit and counterLeft>=leftLimit and counterUp>=upLimit){
              
              display.clearDisplay();
              display.setCursor(0, 0); 
              display.println("Rotator Cuff Recovery");             
              display.println("Good work :)");         
              display.println("You are done for today.");         
              
              for(;;); // Don't proceed, loop forever
          
          }  
         
         ei_printf("Right (%d)", counterRight);
         ei_printf("Left (%d)", counterLeft);
         ei_printf("Up (%d)", counterUp);
                        
        ei_printf("]\n");

        delay(run_inference_every_ms);
    }

    ei_classifier_smooth_free(&smooth);
    
}

/**
* @brief      Get data and run inferencing
*
* @param[in]  debug  Get debug info if true
*/
void loop()
{
    while (1) {
        // Determine the next tick (and then sleep later)
        uint64_t next_tick = micros() + (EI_CLASSIFIER_INTERVAL_MS * 1000);

        // roll the buffer -3 points so we can overwrite the last one
        numpy::roll(buffer, EI_CLASSIFIER_DSP_INPUT_FRAME_SIZE, -3);

        // read to the end of the buffer
        IMU.readAcceleration(
            buffer[EI_CLASSIFIER_DSP_INPUT_FRAME_SIZE - 3],
            buffer[EI_CLASSIFIER_DSP_INPUT_FRAME_SIZE - 2],
            buffer[EI_CLASSIFIER_DSP_INPUT_FRAME_SIZE - 1]
        );

        buffer[EI_CLASSIFIER_DSP_INPUT_FRAME_SIZE - 3] *= CONVERT_G_TO_MS2;
        buffer[EI_CLASSIFIER_DSP_INPUT_FRAME_SIZE - 2] *= CONVERT_G_TO_MS2;
        buffer[EI_CLASSIFIER_DSP_INPUT_FRAME_SIZE - 1] *= CONVERT_G_TO_MS2;

        // and wait for next tick
        uint64_t time_to_wait = next_tick - micros();
        delay((int)floor((float)time_to_wait / 1000.0f));
        delayMicroseconds(time_to_wait % 1000);
    }
}

#if !defined(EI_CLASSIFIER_SENSOR) || EI_CLASSIFIER_SENSOR != EI_CLASSIFIER_SENSOR_ACCELEROMETER
#error "Invalid model for current sensor"
#endif
